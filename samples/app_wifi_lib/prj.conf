## CMakeLists.txt
```
cmake_minimum_required(VERSION 3.20.0)
find_package(Zephyr REQUIRED HINTS $ENV{ZEPHYR_BASE})
project(app_wifi_lib_basic)

target_sources(app PRIVATE src/main.c)
```

## prj.conf
```kconfig
CONFIG_APP_WIFI_LIB=y
CONFIG_LOG=y
CONFIG_LOG_DEFAULT_LEVEL=3


CONFIG_SETTINGS=y

CONFIG_BT_DEVICE_NAME="app_wifi_lib"
CONFIG_BT=y
CONFIG_BT_PERIPHERAL=y
CONFIG_BT_SETTINGS=y

# nvs
CONFIG_NVS=y
CONFIG_FLASH=y


## Wifi related
# Wi-Fi Configuration
CONFIG_WIFI=y

# Network Configuration
CONFIG_NET_CONFIG_AUTO_INIT=n
CONFIG_NET_CONNECTION_MANAGER=y
CONFIG_NET_DHCPV4=y
CONFIG_NET_DHCPV4_SERVER=y
CONFIG_NET_IF_MAX_IPV4_COUNT=2
CONFIG_NET_IF_MAX_IPV6_COUNT=2
CONFIG_NET_IPV4=y
CONFIG_NET_L2_ETHERNET=y
CONFIG_NET_L2_WIFI_MGMT=y
CONFIG_NET_MGMT=y
CONFIG_NET_MGMT_EVENT=y
CONFIG_NET_MGMT_EVENT_INFO=y
CONFIG_NET_MGMT_EVENT_QUEUE_SIZE=10
CONFIG_NET_MGMT_EVENT_STACK_SIZE=4096
CONFIG_NET_PKT_RX_COUNT=16
CONFIG_NET_PKT_TX_COUNT=16
CONFIG_NET_SOCKETS_SERVICE_STACK_SIZE=4096
CONFIG_NET_TCP=y
CONFIG_NET_UDP=y
CONFIG_NETWORKING=y

# LOG Configuration
CONFIG_NET_LOG=y
CONFIG_NET_DHCPV4_SERVER_LOG_LEVEL_DBG=y
CONFIG_ESP32_WIFI_STA_RECONNECT=y

CONFIG_APP_WIFI_DEFAULT_SSID="ssid"
CONFIG_APP_WIFI_DEFAULT_PSK="psk"
```

## src/main.c
```c
#include <app_wifi_lib/app_wifi_lib.h>
#include <zephyr/kernel.h>

int main(void) {
  app_wifi_lib_init();

  int result = app_wifi_lib_do_something(21);
  printk("Result = %d\n", result);

  while (1) {
    k_sleep(K_SECONDS(1));
  }
}
```
