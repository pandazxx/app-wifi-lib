## CMakeLists.txt
```
cmake_minimum_required(VERSION 3.20.0)
find_package(Zephyr REQUIRED HINTS $ENV{ZEPHYR_BASE})
project(__MODULE_NAME___basic)

target_sources(app PRIVATE src/main.c)
```

## prj.conf
```kconfig
CONFIG___MODULE_NAME_UPPER__=y
CONFIG_LOG=y
CONFIG_LOG_DEFAULT_LEVEL=3
```

## src/main.c
```c
#include <__MODULE_NAME__/__MODULE_NAME__.h>
#include <zephyr/kernel.h>

int main(void) {
  __MODULE_NAME___init();

  int result = __MODULE_NAME___do_something(21);
  printk("Result = %d\n", result);

  while (1) {
    k_sleep(K_SECONDS(1));
  }
}
```
