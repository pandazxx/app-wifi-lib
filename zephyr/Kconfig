## zephyr/Kconfig
```kconfig
menu "app_wifi_lib options"

config APP_WIFI_LIB
    bool "Enable app_wifi_lib Library"
    default y
    help
      Enable support for app_wifi_lib.


config APP_WIFI_DEFAULT_SSID
    string "Default ssid to connect to"
    help
      The default ssid to connect to

config APP_WIFI_DEFAULT_PSK
    string "Default PSK"
    help
      Default PSK

endmenu
```
